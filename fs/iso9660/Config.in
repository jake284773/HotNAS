## fs/iso9660/Config.in
```kconfig
config BR2_TARGET_ROOTFS_ISO9660
	bool "iso image"
	depends on (BR2_i386 || BR2_x86_64)
	depends on BR2_LINUX_KERNEL
	select BR2_TARGET_ROOTFS_EXT2
	select BR2_TARGET_SYSLINUX
	select BR2_TARGET_ROOTFS_EXT2_GZIP
	help
	  Build a bootable iso9660 image

config BR2_TARGET_ROOTFS_ISO9660_BOOT_MENU
	string "Boot isolinux.cfg file"
	depends on BR2_TARGET_ROOTFS_ISO9660
	default "fs/iso9660/isolinux.cfg"

comment "iso image requires a Linux kernel to be built"
	depends on (BR2_i386 || BR2_x86_64) && !BR2_LINUX_KERNEL
```

## package/mtdaapd/Config.in
```kconfig
config BR2_PACKAGE_MTDAAPD
	bool "mt-daapd (BROKEN!)"
	select BR2_PACKAGE_LIBID3TAG
	select BR2_PACKAGE_SQLITE
	help
	  mt-daapd (Firefly Media Server)
	  The best open-source media server for the Roku SoundBridge and iTunes.

	  http://www.fireflymediaserver.org/index.php

config BR2_PACKAGE_MTDAAPD_OGGVORBIS
	bool "ogg-vorbis support"
	default y
	depends on BR2_PACKAGE_MTDAAPD
	help
	  Enable Ogg-Vorbis support in mt-daapd.

config BR2_PACKAGE_MTDAAPD_FLAC
	bool "flac support"
	default y
	depends on BR2_PACKAGE_MTDAAPD
	help
	  Enable FLAC support in mt-daapd.
```

## package/sshpass/Config.in
```kconfig
config BR2_PACKAGE_SSHPASS
	bool "sshpass"
	help
	  Allows non-interactive ssh login
```
